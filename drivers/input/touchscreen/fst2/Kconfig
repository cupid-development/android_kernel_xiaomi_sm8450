## drivers/input/touchscreen/fst2/Kconfig
```kconfig
config TOUCHSCREEN_FST2
	tristate "STMicroelectronics multitouch touchscreen - FingerTipS (FST2)"
	depends on I2C || SPI
	help
	  Say Y here to enable STMicroelectronics (FST2) touchscreen support.
	  If unsure, say N.
	  To compile this driver as a module, choose M here: the module
	  will be called fst2.
```

## drivers/input/touchscreen/fts_dual/Kconfig
```kconfig
config TOUCHSCREEN_ST_FTS_SPI_DUAL
	tristate "ST FTS SPI DUAL Touchscreen"
	depends on I2C
	help
	  Say Y here if you have ST FTS series SPI touchscreen.

	  If unsure, say N.

	  To compile this driver as a module, choose M here: the
	  modules will be named fts_touch_spi_pri and
	  fts_touch_spi_sec
```

## drivers/input/touchscreen/fts_spi/Kconfig
```kconfig
config TOUCHSCREEN_ST_FTS_V521_SPI
	tristate "ST FTS V521 I2C Touchscreen"
	depends on I2C
	help
	  Say Y here if you have ST FTS series I2C touchscreen.

	  If unsure, say N.

	  To compile this driver as a module, choose M here.

config TOUCHSCREEN_ST_FTS_V521_SPI_SECONDARY
	bool "Build as a secondary touch module"
	depends on TOUCHSCREEN_ST_FTS_V521_SPI
	help
	  Say Y here if you want to build this driver as a secondary touch module
	  instead of the primary one.

	  If unsure, say N.
```

## drivers/input/touchscreen/xiaomi/Kconfig
```kconfig
config TOUCHSCREEN_XIAOMI_TOUCHFEATURE
	tristate "Xiaomi Touch Feature"
	depends on DRM
	depends on INPUT_TOUCHSCREEN
	depends on OF
	help
	  Say Y here if you want to enable xiaomi touch feature.

	  If unsure, say N.

	  To compile this driver as a module, choose M here.
```

## drivers/misc/hwid/Kconfig
```kconfig
config MI_HARDWARE_ID
	tristate "Register xiaomi hwid module"
	default n
	help
	  This adds support for mi hwid.
```
